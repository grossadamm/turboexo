## firmware/cluster/main/Kconfig.projbuild
```kconfig
menu "TurboExo cluster"

config CLUSTER_PANEL_ROTATE_270
    bool "Rotate panel 270 degrees (default 90 degrees)"
    default n

config CLUSTER_LIVE
    bool "Use Speeduino UART1 instead of replay"
    default n
    help
        Live mode starts inhibited on every boot. An actual ECU reset
        followed by a two-second Mode hold is required to send any request.

if CLUSTER_LIVE

config CLUSTER_ECU_VSS
    bool "Display a configured and verified ECU vehicle speed sensor"
    default n

config CLUSTER_ECU_OIL_PRESSURE
    bool "Display a configured and verified ECU oil pressure sender"
    default n

config CLUSTER_EGO_DELAY_MS
    int "Saved ECU EGO delay in milliseconds"
    range 0 255000
    default 15000

config CLUSTER_ADS1115
    bool "Build optional external ADS1115 input support"
    default n
    help
        I2C is initialized only when at least one valid measured calibration
        is supplied. ADDR is strapped to GND (0x48).

if CLUSTER_ADS1115

config CLUSTER_ADS1115_FUEL_KNOTS
    string "A0 fuel calibration: ascending raw:value pairs separated by commas"
    default ""
    help
        Supply 2 to 16 measured counts and fuel percentages (0 to 100).

config CLUSTER_ADS1115_OIL_TEMP_KNOTS
    string "A1 oil temperature calibration: ascending raw:value pairs separated by commas"
    default ""
    help
        Supply 2 to 16 measured counts and temperatures in degrees Fahrenheit
        (-40 to 400).

endif
endif

config CLUSTER_SD_LOGGING
    bool "Log telemetry to the onboard microSD card"
    default n
    help
        Mount an existing FAT volume at startup. Logging stops on removal or
        write failure. The card is never formatted automatically.

endmenu
```

## firmware/cluster/sdkconfig.defaults
```kconfig
CONFIG_IDF_TARGET="esp32p4"
CONFIG_ESPTOOLPY_FLASHSIZE_32MB=y
CONFIG_PARTITION_TABLE_CUSTOM=y
CONFIG_SPIRAM=y
CONFIG_SPIRAM_MODE_HEX=y
CONFIG_SPIRAM_SPEED_200M=y
CONFIG_ESP_CONSOLE_USB_SERIAL_JTAG=y
CONFIG_FREERTOS_HZ=1000
CONFIG_ESP32P4_LCD_70=y
CONFIG_ESP32P4_LCD_NOTOUCH=y
CONFIG_ESP32P4_LCD_I2C0=y
CONFIG_LVGL_PORT_ENABLE_PPA=y
CONFIG_LV_COLOR_DEPTH_16=y
CONFIG_LV_DRAW_BUF_ALIGN=64
CONFIG_ESP_MAIN_TASK_STACK_SIZE=8192
CONFIG_LV_MEM_POOL_EXPAND_SIZE_KILOBYTES=512
# CONFIG_LV_BUILD_EXAMPLES is not set
# CONFIG_LV_BUILD_DEMOS is not set
CONFIG_LV_USE_LOG=y
CONFIG_LV_LOG_LEVEL_WARN=y
```
